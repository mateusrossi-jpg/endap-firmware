## sdkconfig.defaults
```kconfig
# Industrial / SRE overrides
CONFIG_ESP_COREDUMP_ENABLE_TO_FLASH=y
CONFIG_ESP_TASK_WDT_PANIC=y
CONFIG_ESP_BROWNOUT_DET=y
CONFIG_APP_ROLLBACK_ENABLE=y

CONFIG_PARTITION_TABLE_CUSTOM=y
CONFIG_PARTITION_TABLE_CUSTOM_FILENAME="partitions.csv"
CONFIG_SPI_FLASH_SUPPORT_BOYA_CHIP=y
CONFIG_I2C_SUPPRESS_DEPRECATE_WARN=y
CONFIG_ETH_SPI_ETHERNET_W5500=y
```
